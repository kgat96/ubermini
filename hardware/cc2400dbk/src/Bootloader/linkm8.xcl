/*****************************************************************************
 *                                                                           *
 *        **********                                                         *
 *       ************                                                        *
 *      ***        ***                                                       *
 *      ***   +++   ***                                                      *
 *      ***   + +   ***                                                      *
 *      ***   +                            CHIPCON CC2400                    *
 *      ***   + +   ***                      LINKER FILE                 	 *
 *      ***   +++   ***                                                      *
 *      ***       ***                                                        *
 *       ***********                                                         *
 *        *********                                                          *
 *                                                                           *
 *****************************************************************************
 * XLINK command file for the ICCAVR C-compiler using the --cpu=m8, -ms		 *																	         *
 * options. Segments are defined for an ATmega8 whithout external			 *
 * Usage: xlink your_file(s) -f link										 *
 * Linker file for Atmega8 CC2400DBK                        				 *                                                                           *
 *****************************************************************************
 * Device:      CC2400                                                       *
 * File:		link.xcl					                                 *
 * Author:		MBR						                                     *
 * Target:		ATmega8						                                 *
 * Created:		2004-01-05					                                 *
 *				    			                                             *
 *****************************************************************************
 * Revision history:                                                         *
 *                                                                           *
 * $Log: linkm8.xcl,v $
 * Revision 1.1  2004/07/20 12:22:20  mbr
 * Bootloader according application note AVR109,
 * Self Programming with only C - code
 *
 * 
 * 
 * 
 * 
 * 
 * 
 *
 * 
 * 
 *
 * 
 * 
 *                                                       					 *
 *                                                                           *  
 *									                                         *	
 *                                                                           *
 *****************************************************************************
 */

/*
 * Modify the lines below to alter the size of the RSTACK, CSTACK and HEAP
 * segments. These need to be fine tuned to suit your specific application.
 * The '_..X_' prefix is used by C-SPY as an indication that the label should
 * not be displayed in the dissassembly window.
 */
-D_..X_CSTACK_SIZE=200  /* 512 bytes for auto variables and saved registers. */
-D_..X_RSTACK_SIZE=40   /* 64 bytes for return addresses, equivalent to 32 */
                        /* levels of calls, including interrupts. */
-D_..X_HEAP_SIZE=100    /* 256 bytes of heap. */

/*
 * Modify these lines if you have an external SRAM connected to the system.
 *
 * Note: Remember to turn on the external data and address busses in
 *       __low_level_init if external memory is used.
 */
-D_..X_EXT_SRAM_BASE=0
-D_..X_EXT_SRAM_SIZE=0

/*
 * Modify these lines if you have an external EPROM connected to the system.
 *
 * Note: Remember to turn on the external data and address busses in
 *       __low_level_init if external memory is used.
 */
-D_..X_EXT_EPROM_BASE=0
-D_..X_EXT_EPROM_SIZE=0

/*
 * Modify these lines if you have an external EEPROM connected to the system.
 *
 * Note: Remember to turn on the external data and address busses in
 *       __low_level_init if external memory is used.
 */
-D_..X_EXT_EEPROM_BASE=0
-D_..X_EXT_EEPROM_SIZE=0

/* Define CPU */
-ca90

/*
 * The following segments are located in the internal memory of
 * the ATmega128. Do not change these lines.
 */

/*====================================================*/
/* Code (flash) segments */
-D_..X_INTVEC_SIZE=26   /* 4 bytes * 35 vectors */
-D_..X_FLASH_TEND=FF    /* End of tiny flash memory */
-D_..X_FLASH_NEND=1FFF  /* End of near flash memory */
-D_..X_FLASH_END=1FFF  /* End of flash memory */
/* Internal data memory */

/* Change the two lines below to 60(BASE) and FF(TEND) if you are running in "mega103 mode" */
-D_..X_SRAM_BASE=60    /* Start of ram memory */
-D_..X_SRAM_TEND=FF     /* End of tiny ram memory */

-D_..X_SRAM_END=45F    /* End of ram memory */
/* Internal EEPROM */
-D_..X_EEPROM_END=1FF   /* End of eeprom memory */
/*====================================================*/

/* Code memory */
-Z(CODE)INTVEC,FAR_F,SWITCH,INITTAB,CODE=1C00-1FFF

/* Internal data memory */
-Z(DATA)TINY_I,TINY_Z,TINY_N=_..X_SRAM_BASE-_..X_SRAM_TEND
-Z(DATA)NEAR_I,NEAR_Z=_..X_SRAM_BASE-_..X_SRAM_END,_..X_EXT_SRAM_BASE-(_..X_EXT_SRAM_BASE+_..X_EXT_SRAM_SIZE)

/*
 * If external SRAM is available it is possible to place the stacks there.
 * However, the external memory is slower than the internal so moving the
 * stacks to the external memory will degrade the system performance.
 */
-Z(DATA)RSTACK+_..X_RSTACK_SIZE=_..X_SRAM_BASE-_..X_SRAM_END /* ,_..X_EXT_SRAM_BASE-(_..X_EXT_SRAM_BASE+_..X_EXT_SRAM_SIZE) */
-Z(DATA)CSTACK+_..X_CSTACK_SIZE=_..X_SRAM_BASE-_..X_SRAM_END /* ,_..X_EXT_SRAM_BASE-(_..X_EXT_SRAM_BASE+_..X_EXT_SRAM_SIZE) */

/*
 * If external SRAM is available it might be a good idea to move the
 * heap segment there, i.e. remove the _..X_SRAM_BASE-_..X_SRAM_END range.
 */
-Z(DATA)HEAP+_..X_HEAP_SIZE=_..X_SRAM_BASE-_..X_SRAM_END,_..X_EXT_SRAM_BASE-(_..X_EXT_SRAM_BASE+_..X_EXT_SRAM_SIZE)

/* Internal eeprom memory */
-Z(XDATA)EEPROM_I,EEPROM_N=0-_..X_EEPROM_END

/*
 * The following segment definitions are only used if external memory is
 * connected to the AVR controller.
 */

/* External EPROM */
-Z(CONST)NEAR_C=_..X_EXT_EPROM_BASE-(_..X_EXT_EPROM_BASE+_..X_EXT_EPROM_SIZE)

/* External EEPROM */
-Z(DATA)NEAR_N=_..X_EXT_EEPROM_BASE-(_..X_EXT_EEPROM_BASE+_..X_EXT_EEPROM_SIZE)

/* Select reduced "printf" support to reduce library size.
   See configuration section in manual concerning printf/sprintf. */

/*Dlib*/
-e_Printf_1=_Printf

/*Clib*/
-e_small_write=_formatted_write
-e_small_write_P=_formatted_write_P

/* Disable floating-point support in "scanf" to reduce library size.
   See configuration section in manual concerning scanf/sscanf */

/*Dlib*/
-e_Scanf_1=_Scanf

/*Clib*/
-e_medium_read=_formatted_read
-e_medium_read_P=_formatted_read_P

/* Suppress one warning which is not relevant for this processor */
-w29

/* Code will now reside in file aout.a90 or aout.d90, unless -o is specified */
/* .d90 is the default if debug system is linked (option -r) */
/* .a90 is the default without debugging. Default format is -Fmotorola */
